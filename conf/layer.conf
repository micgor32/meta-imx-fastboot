## conf/layer.conf
```bitbake
# We have a conf and classes directory, add to BBPATH
BBPATH .= ":${LAYERDIR}"

# We have recipes-* directories, add to BBFILES
BBFILES += "${LAYERDIR}/recipes-*/*/*.bb \
            ${LAYERDIR}/recipes-*/*/*.bbappend"

BBFILE_COLLECTIONS += "meta-imx-fastboot"
BBFILE_PATTERN_meta-imx-fastboot = "^${LAYERDIR}/"
BBFILE_PRIORITY_meta-imx-fastboot = "6"

BBFILES_DYNAMIC += " imx-secure-boot:${LAYERDIR}/dynamic-layers/meta-secure-boot/recipes-secure-boot/*/*.bbappend "

LAYERDEPENDS_meta-imx-fastboot = "core"
LAYERSERIES_COMPAT_meta-imx-fastboot = "walnascar"

UBOOT_TARGET = "u-boot-atf-container.img"
KERNEL_TARGET = "kernel-atf-dtb-container.img"

UBOOT_TARGET:mx8m-generic-bsp = "u-boot-atf.itb"
KERNEL_TARGET:mx8m-generic-bsp = "kernel-atf-dtb.itb"

IMXBOOT_TARGETS_BASENAME:mx8ulp-generic-bsp = "flash_singleboot_m33"
IMXBOOT_TARGETS:append:mx8ulp-generic-bsp = " ${IMXBOOT_TARGETS_BASENAME}_no_uboot"
IMAGE_IMXBOOT_TARGET:mx8ulp-generic-bsp ?= "${IMXBOOT_TARGETS_BASENAME}_no_uboot"

IMXBOOT_TARGETS_BASENAME:mx8mq-generic-bsp = "flash_evk"
KERNEL_DEVICETREE_BASENAME:mx8mq-generic-bsp = "imx8mq-evk"

IMXBOOT_TARGETS:append:mx8m-generic-bsp = " ${IMXBOOT_TARGETS_BASENAME}_dual_bootloader"
IMAGE_IMXBOOT_TARGET:mx8m-generic-bsp ?= "${IMXBOOT_TARGETS_BASENAME}_dual_bootloader"

IMXBOOT_TARGETS_BASENAME:mx93-generic-bsp = "flash_singleboot"
IMXBOOT_TARGETS:append:mx93-generic-bsp = " ${IMXBOOT_TARGETS_BASENAME}_no_uboot"
IMAGE_IMXBOOT_TARGET:mx93-generic-bsp ?= "${IMXBOOT_TARGETS_BASENAME}_no_uboot"

IMXBOOT_TARGETS:append:mx95-generic-bsp = " ${IMXBOOT_TARGETS_BASENAME}_all_no_uboot ${IMXBOOT_TARGETS_BASENAME}_a55_no_uboot"
IMAGE_IMXBOOT_TARGET:mx95-generic-bsp ?= "${IMXBOOT_TARGETS_BASENAME}_all_no_uboot"

IMXBOOT_TARGETS:append:mx943-generic-bsp = " ${IMXBOOT_TARGETS_BASENAME}_all_no_uboot ${IMXBOOT_TARGETS_BASENAME}_a55_no_uboot"
IMAGE_IMXBOOT_TARGET:mx943-generic-bsp ?= "${IMXBOOT_TARGETS_BASENAME}_all_no_uboot"

FALCON_KERNEL_DEVICETREE ?= "${KERNEL_DEVICETREE_BASENAME}"

MACHINE_FEATURES:remove = "optee"
```
